## drivers/net/wireless/rockchip_wlan/Kconfig.rej
```kconfig
diff a/drivers/net/wireless/rockchip_wlan/Kconfig b/drivers/net/wireless/rockchip_wlan/Kconfig	(rejected hunks)
@@ -39,5 +39,6 @@ endif
 source "drivers/net/wireless/rockchip_wlan/cywdhd/Kconfig"
 source "drivers/net/wireless/rockchip_wlan/infineon/Kconfig"
 source "drivers/net/wireless/rockchip_wlan/rtl8852be/Kconfig"
+source "drivers/net/wireless/rockchip_wlan/rtl8852bu/Kconfig"
 
 endif # WL_ROCKCHIP
```
